## dts/bindings/radio_fem/generic-fem-two-ctrl-pins.yaml
```yaml
# Copyright (c) 2020 Nordic Semiconductor ASA
# SPDX-License-Identifier: LicenseRef-BSD-5-Clause-Nordic

description: >
    This is a representation of (TODO: generic) Radio Front-End module.

compatible: "generic-fem-two-ctrl-pins"

include: base.yaml

properties:
    ctx-gpios:
        type: phandle-array
        required: false
        description: >
            Gpio of the SOC controlling CTX pin of the SKY66112-11

    crx-gpios:
        type: phandle-array
        required: false
        description: >
            Gpio of the SOC controlling CRX pin of the SKY66112-11

    ctx-settle-time-us:
        type: int
        description: >
            Settling time in microseconds from activation of CTX to transmit.

    crx-settle-time-us:
        type: int
        description: >
            Settling time in microseconds from activation of CRX to receive.

    tx-gain-db:
        type: int
        description: >
            TX gain of the PA amplifier of SKY66112-11 in dB.

    rx-gain-db:
        type: int
        description: >
            RX gain of the LNA amplifier of SKY66112-11 in dB.
```

## dts/bindings/radio_fem/nordic,nrf21540-fem.yaml
```yaml
# Copyright (c) 2020 Nordic Semiconductor ASA
# SPDX-License-Identifier: LicenseRef-BSD-5-Clause-Nordic

description: >
    This is a representation of the nRF21540 Radio Front-End module

compatible: "nordic,nrf21540-fem"

include: base.yaml

properties:
    tx-en-gpios:
        type: phandle-array
        required: false
        description: >
            Gpio of the SOC controlling TX_EN pin of the nRF21540

    rx-en-gpios:
        type: phandle-array
        required: false
        description: >
            Gpio of the SOC controlling RX_EN pin of the nRF21540

    pdn-gpios:
        type: phandle-array
        required: false
        description: >
            Gpio of the SOC controlling PDN pin of the nRF21540

    tx-en-settle-time-us:
        type: int
        default: 10
        description: >
            Settling time in microseconds from state PG to TX

    rx-en-settle-time-us:
        type: int
        default: 10
        description: >
            Settling time in microseconds from state PG to RX

    pdn-settle-time-us:
        type: int
        default: 17
        description: >
            Settling time in microseconds from state PD to PG

    trx-hold-time-us:
        type: int
        default: 3
        description: >
            Power-off time in microseconds when changing from RX or TX to PG

    tx-gain-db:
        type: int
        default: 20
        description: >
            TX gain of the nRF21540 PA amplifier in dB.

    rx-gain-db:
        type: int
        default: 20
        description: >
            RX gain of the nRF21540 LNA amplifier in dB.
```

## dts/bindings/radio_fem/skyworks,sky66112-11.yaml
```yaml
# Copyright (c) 2020 Nordic Semiconductor ASA
# SPDX-License-Identifier: LicenseRef-BSD-5-Clause-Nordic

description: >
    This is a representation of the Skyworks SKY66112-11 Radio Front-End module.

compatible: "skyworks,sky66112-11"

include: base.yaml

properties:
    ctx-gpios:
        type: phandle-array
        required: false
        description: >
            Gpio of the SOC controlling CTX pin of the SKY66112-11

    crx-gpios:
        type: phandle-array
        required: false
        description: >
            Gpio of the SOC controlling CRX pin of the SKY66112-11

    ctx-settle-time-us:
        type: int
        default: 23
        description: >
            Settling time in microseconds from activation of CTX to trasnsmit.

    crx-settle-time-us:
        type: int
        default: 5
        description: >
            Settling time in microseconds from activation of CRX to receive.

    tx-gain-db:
        type: int
        default: 22
        description: >
            TX gain of the PA amplifier of SKY66112-11 in dB.

    rx-gain-db:
        type: int
        default: 11
        description: >
            RX gain of the LNA amplifier of SKY66112-11 in dB.
```

## samples/zigbee/light_switch/sample.yaml
```yaml
sample:
  description: Zigbee dimmable light switch based on ZBOSS stack
  name: Zigbee Light switch
tests:
  sample.zigbee.light_switch:
    sysbuild: true
    build_only: true
    integration_platforms:
      - nrf52840dk/nrf52840
      - nrf52833dk/nrf52833
      - nrf5340dk/nrf5340/cpuapp
      - nrf21540dk/nrf52840
    platform_allow: nrf52840dk/nrf52840 nrf52833dk/nrf52833 nrf5340dk/nrf5340/cpuapp
      nrf21540dk/nrf52840
    tags: ci_build smoke sysbuild ci_samples_zigbee
  sample.zigbee.light_switch.fota.nrf5340dk:
    sysbuild: true
    build_only: true
    extra_args: >
      FILE_SUFFIX=fota
      SB_CONFIG_PARTITION_MANAGER=y
      SB_CONFIG_PM_EXTERNAL_FLASH_MCUBOOT_SECONDARY=y
      SB_CONFIG_MCUBOOT_UPDATEABLE_IMAGES=2
      SB_CONFIG_MCUBOOT_MODE_OVERWRITE_ONLY=y
      SB_CONFIG_DFU_MULTI_IMAGE_PACKAGE_NET=y
      SB_CONFIG_NETCORE_802154_RPMSG=y
      SB_CONFIG_SECURE_BOOT_NETCORE=y
      SB_CONFIG_NETCORE_APP_UPDATE=y
    integration_platforms:
      - nrf5340dk/nrf5340/cpuapp
    platform_allow: nrf5340dk/nrf5340/cpuapp
    tags: ci_build smoke sysbuild ci_samples_zigbee
```

## subsys/mpsl/Kconfig.fem
```kconfig
#
# Copyright (c) 2019 - 2020 Nordic Semiconductor ASA
#
# SPDX-License-Identifier: LicenseRef-BSD-5-Clause-Nordic
#

DT_COMPAT_NORDIC_NRF21540_GPIO := nordic,nrf21540-fem
DT_COMPAT_SKYWORKS_SKY66112_11 := skyworks,sky66112-11

config MPSL_FEM_NRF21540_GPIO_SUPPORT
	bool
	default $(dt_nodelabel_has_compat,nrf_radio_fem,$(DT_COMPAT_NORDIC_NRF21540_GPIO)) && !BT

config MPSL_FEM_SKY66112_11_SUPPORT
	bool
	default $(dt_nodelabel_has_compat,nrf_radio_fem,$(DT_COMPAT_SKYWORKS_SKY66112_11))

config MPSL_FEM
	bool "Radio front-end module (FEM) support"
# MPSL FEM is not supported on 53 yet
	depends on !(SOC_NRF5340_CPUAPP || SOC_NRF5340_CPUNET) && \
		   (MPSL_FEM_NRF21540_GPIO_SUPPORT || MPSL_FEM_SKY66112_11_SUPPORT)
	default y
	help
	  Controls if front-end module (FEM) is to be configured and enabled
	  when MPSL is initialized. Default type of FEM to use depends on which
	  compatible nodes are in devicetree.

if MPSL_FEM

choice MPSL_FEM_CHOICE
	prompt "Radio front-end module (FEM) type"

config MPSL_FEM_NRF21540_GPIO
	depends on MPSL_FEM_NRF21540_GPIO_SUPPORT
	bool "nRF21540 front-end module in GPIO mode"
	help
	  FEM device is nRF21540 and its control mode is GPIO.
	  Note: nRF21540 is unavailable when Bluetooth LE is enabled

config MPSL_FEM_SKY66112_11
	depends on MPSL_FEM_SKY66112_11_SUPPORT
	bool "SKY66112-11 front-end module"
	help
	  FEM device is SKY66112-11 or other device with compatible control
	  interface.

endchoice	# MPSL_FEM_CHOICE

if MPSL_FEM_NRF21540_GPIO

config MPSL_FEM_NRF21540_GPIO_GPIOTE_TX_EN
	int "GPIOTE channel number used to control TX_EN pin"
	default 7
	help
	  Unique GPIOTE channel number to be used exclusively by the FEM driver
	  for TX_EN pin control.

config MPSL_FEM_NRF21540_GPIO_GPIOTE_RX_EN
	int "GPIOTE channel number used to control RX_EN pin"
	default 6
	help
	  Unique GPIOTE channel number to be used exclusively by the FEM driver
	  for RX_EN pin control.

config MPSL_FEM_NRF21540_GPIO_GPIOTE_PDN
	int "GPIOTE channel number used to control PDN pin"
	default 5
	help
	  Unique GPIOTE channel number to be used exclusively by the FEM driver
	  for PDN pin control.

config MPSL_FEM_NRF21540_GPIO_PPI_CHANNEL_0
	int "PPI channel reserved for the front-end module"
	default 15
	help
	  The first of three unique PPI channel numbers to be used exclusively
	  by the FEM driver.

config MPSL_FEM_NRF21540_GPIO_PPI_CHANNEL_1
	int "PPI channel reserved for the front-end module"
	default 16
	help
	  The second of three unique PPI channel numbers to be used exclusively
	  by the FEM driver.

config MPSL_FEM_NRF21540_GPIO_PPI_CHANNEL_2
	int "PPI channel reserved for the front-end module"
	default 5
	help
	  Third of three unique PPI channel numbers to be used exclusively
	  by the FEM driver.

config MPSL_FEM_NRF21540_TX_GAIN_DB
	int "TX gain of the nRF21540 PA amplifier in dB"
	default 20
	help
	  The default value of 20 dB is based on nRF21540 Product Specification
	  (v1.0) and it corresponds to the configuration in which the pin
	  MODE=0 and pin POUTA_SEL=0

config MPSL_FEM_NRF21540_RX_GAIN_DB
	int "RX gain of the nRF21540 LNA amplifier in dB"
	default 13
	help
	  The default value of 13 dB is based on nRF21540 Product Specification
	  (v1.0)

endif

if MPSL_FEM_SKY66112_11

config MPSL_FEM_SKY66112_11_GPIOTE_CTX
	int "GPIOTE channel number used to control CTX pin"
	default 7
	help
	  Unique GPIOTE channel number to be used exclusively by the FEM driver
	  for CTX pin control.

config MPSL_FEM_SKY66112_11_GPIOTE_CRX
	int "GPIOTE channel number used to control CRX pin"
	default 6
	help
	  Unique GPIOTE channel number to be used exclusively by the FEM driver
	  for RTX pin control.

config MPSL_FEM_SKY66112_11_PPI_CHANNEL_0
	int "PPI channel reserved for the front-end module"
	default 15
	help
	  The first of two unique PPI channel numbers to be used exclusively
	  by the FEM driver.

config MPSL_FEM_SKY66112_11_PPI_CHANNEL_1
	int "PPI channel reserved for the front-end module"
	default 16
	help
	  The second of two unique PPI channel numbers to be used exclusively
	  by the FEM driver.

endif

endif	# MPSL_FEM
```
